## drivers/i2c/chips/Kconfig
```kconfig
#
# Miscellaneous I2C chip drivers configuration
#
# *** DEPRECATED! Do not add new entries! See Makefile ***
#

menu "Miscellaneous I2C Chip support"

config SENSORS_NFC_PN544
	tristate "PN544 NFC sensor support"
	depends on I2C=y
	help
	  PN544 NFC Driver implemented.
endmenu
```
